## sdkconfig.defaults
```kconfig
# Default sdkconfig settings for LVGL weather project

# Set target to esp32s3
CONFIG_IDF_TARGET="esp32s3"

# FreeRTOS config
CONFIG_FREERTOS_HZ=1000

# SPI RAM config (Often available on ESP32-S3)
CONFIG_SPIRAM=y
CONFIG_SPIRAM_MODE_OCT=y
CONFIG_SPIRAM_SPEED_80M=y
CONFIG_SPIRAM_FETCH_INSTRUCTIONS=y
CONFIG_SPIRAM_RODATA=y
CONFIG_SPIRAM_IGNORE_NOTFOUND=y

# LVGL Config
CONFIG_LV_COLOR_16_SWAP=y
CONFIG_LV_MEM_CUSTOM=y

# NVS Config
CONFIG_ESPTOOLPY_FLASHSIZE_4MB=y
CONFIG_PARTITION_TABLE_CUSTOM=y
CONFIG_PARTITION_TABLE_CUSTOM_FILENAME="partitions.csv"
CONFIG_LV_FONT_MONTSERRAT_48=y
CONFIG_LV_FONT_MONTSERRAT_16=y
CONFIG_LV_FONT_SIMSUN_16_CJK=y
```
